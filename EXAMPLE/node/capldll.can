/*@!Encoding:1252*/
includes
{
#if X64
  #pragma library("..\Exec64\capldll.dll")
#else
  #pragma library("..\Exec32\capldll.dll")
#endif
}

variables 
{
  int socketResult = 0;
  int numberOfBytesReceived = 0;
  int i = 0;
  char receivedMessage[512];
}


on start 
{
  write("CAPL DLL VERSION: %d", caplGetDLLVersion());
  socketResult = caplSocketConnect(12341);
  write("SOCKET CONNECT: %d", socketResult);
}

on key 's' {
  write("Send message: 'Mesaj'");
  socketResult = caplSocketSend("Mesaj");
  write("Bytes send: %d", socketResult);
  numberOfBytesReceived = caplSocketReceive(receivedMessage);
  write("Received response with length: %d", numberOfBytesReceived); 
  write("Received message: %s", receivedMessage);
  
}


on preStop 
{
  socketResult = caplSocketShutdown();
  write("SOCKET SHUTDOWN: %d", socketResult);
  socketResult = caplSocketClose();
  write("SOCKET CLOSE: %d", socketResult);
} 